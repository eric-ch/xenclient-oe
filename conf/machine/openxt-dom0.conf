## conf/machine/openxt-dom0.conf
```bitbake
#@TYPE: Machine
#@NAME: xenclient-dom0
#@DESCRIPTION: Machine configuration for OpenXT dom0.

require openxt-common.conf

MACHINE_FEATURES = " \
    acpi \
    ethernet \
    ext2 \
    keyboard \
    pci \
    rtc \
    screen \
    usbhost \
    x86 \
"

module_conf_i915 = "options i915 enable_psr=0"

KERNEL_MODULE_PROBECONF += " \
    i915 \
"

# Use OpenXT Linux patched kernel.
PREFERRED_PROVIDER_virtual/kernel = "linux-yocto-openxt-dom0"
```

## conf/machine/openxt-ndvm.conf
```bitbake
#@TYPE: Machine
#@NAME: openxt-ndvm
#@DESCRIPTION: Machine configuration for OpenXT NDVM.

require openxt-common.conf

MACHINE_FEATURES = " \
    ethernet \
    ext2 \
    pci \
    serial \
    x86 \
"

APPEND = "root=/dev/xvda2 ro console=hvc0 iommu=soft"

USE_VT = "0"

# Use OpenXT Linux patched kernel.
PREFERRED_PROVIDER_virtual/kernel = "linux-yocto-openxt-ndvm"
```

## conf/machine/openxt-stubdom.conf
```bitbake
#@TYPE: Machine
#@NAME: openxt-stubdom
#@DESCRIPTION: Machine configuration for OpenXT stub-domain.

require openxt-common.conf

MACHINE_FEATURES = " \
    ethernet \
    ext2 \
    pci \
    serial \
    x86 \
"

USE_VT = "0"

# Use OpenXT Linux patched kernel.
PREFERRED_PROVIDER_virtual/kernel = "linux-yocto-openxt-stubdom"
```

## conf/machine/xenclient-uivm.conf
```bitbake
# Copyright (C) 2010 Citrix Systems
# Released under the MIT license (see packages/COPYING)
#@TYPE: Machine
#@NAME: xenclient-uivm
#@DESCRIPTION: Machine configuration for XenClient uivm VM

require xenclient-common.conf

MACHINE_FEATURES = "screen keyboard ethernet pci acpi ext2 x86"

USE_VT = "0"

module_conf_xen-fbfront = "blacklist xen-fbfront"
KERNEL_MODULE_PROBECONF += " \
    xen-fbfront \
"

module_conf_ivc = "options ivc dyndbg=+p"
module_conf_pv-display-helper = "options pv_display_helper dyndbg=+p"
module_conf_openxtfb = "options openxtfb dyndbg=+p"

KERNEL_MODULE_PROBECONF += " \
    ivc \
    pv-display-helper \
    openxtfb \
"
```
